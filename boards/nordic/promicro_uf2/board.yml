## boards/nordic/promicro_uf2/board.yml
```yaml
# Copyright (c) 2024 Nordic Semiconductor ASA
# SPDX-License-Identifier: Apache-2.0

board:
  name: promicro_uf2
  full_name: ProMicro nRF52840 UF2
  vendor: nordic
  socs:
    - name: nrf52840
      variants:
      - name: 'i2c'
      - name: 'spi'
```

## boards/slimevr/slimevrmini_p3r6_uf2/board.yml
```yaml
# Copyright (c) 2024 Nordic Semiconductor ASA
# SPDX-License-Identifier: Apache-2.0

board:
  name: slimevrmini_p3r6_uf2
  full_name: SlimeVR Mini P3 R6 UF2
  vendor: slimevr
  socs:
    - name: nrf52833
```

## boards/slimevr/slimevrmini_p4r9_uf2/board.yml
```yaml
# Copyright (c) 2024 Nordic Semiconductor ASA
# SPDX-License-Identifier: Apache-2.0

board:
  name: slimevrmini_p4r9_uf2
  full_name: SlimeVR Mini P4 R9 UF2
  vendor: slimevr
  socs:
    - name: nrf52833
```
